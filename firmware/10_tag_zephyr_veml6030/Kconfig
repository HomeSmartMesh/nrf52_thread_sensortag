## firmware/boards/arm/nrf52840_sensortag/Kconfig.board
```kconfig
# nrf52840dk_nrf52840 board configuration

# Copyright (c) 2016 Nordic Semiconductor ASA
# SPDX-License-Identifier: Apache-2.0

config BOARD_NRF52840_SENSORTAG
	bool "nrf52840 Sensor Tag"
	depends on SOC_NRF52840_QIAA
```

## firmware/boards/arm/nrf52840_sensortag/Kconfig.defconfig
```kconfig
# nRF52840 DK NRF52840 board configuration

# Copyright (c) 2016 Nordic Semiconductor ASA
# SPDX-License-Identifier: Apache-2.0

if BOARD_NRF52840_SENSORTAG

config BOARD
	default "nrf52840_sensortag"

endif # BOARD_NRF52840_SENSORTAG
```

## firmware/drivers/Kconfig
```kconfig
# drivers configuration options

# Copyright (c) 2015 Intel Corporation
# SPDX-License-Identifier: Apache-2.0

menu "Device Drivers"

rsource "veml6030/Kconfig"

endmenu
```

## firmware/drivers/veml6030/Kconfig
```kconfig
# VEML6030 light sensor configuration options

# Copyright (c) 2016 Intel Corporation
# SPDX-License-Identifier: Apache-2.0

config VEML6030
	bool "VEML6030 Light Sensor"
	depends on I2C
	help
	  Enable driver for VEML6030 light sensors.
```
